## Kconfig
```kconfig
config MFD_SPACEMIT_PMIC
	tristate "SpacemiT PMIC"
	depends on ARCH_SPACEMIT
	depends on I2C && OF
	select MFD_CORE
	select REGMAP_I2C
	select REGMAP_IRQ
	help
	  If this option is turned on, the P1 chip produced by SpacemiT will
	  be supported.

	  This driver can also be compiled as a module. If you choose to build
	  it as a module, the resulting kernel module will be named `spacemit-pmic`.
```

## p1-regulator/Kconfig
```kconfig
config REGULATOR_SPACEMIT
	tristate "Spacemit regulator support"
	depends on MFD_SPACEMIT_PMIC
	select REGULATOR_FIXED_VOLTAGE
	help
	  This driver provides support for the voltage regulators on the
	  spacemit pmic.
```
